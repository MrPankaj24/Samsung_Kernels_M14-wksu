## kernel_platform/common/arch/arm64/configs/gki_sec_defconfig
```kconfig
# Samsung defconfig for GKI build
# SEC_PRODUCT_FEATURE_KNOX_SUPPORT_NPA
CONFIG_KNOX_NCM=y

# KNOX-DDAR
CONFIG_DDAR=y

# [ SEC_SELINUX_PORTING_COMMON
CONFIG_EXT4_FS_SECURITY=y
CONFIG_AUDIT=y
CONFIG_LSM_MMAP_MIN_ADDR=4096
CONFIG_SECURITY_SELINUX=y
CONFIG_DEFAULT_SECURITY_SELINUX=y
CONFIG_NETFILTER_ADVANCED=y
CONFIG_NETFILTER_XT_TARGET_LOG=y
CONFIG_SECURITY_SELINUX_DEVELOP=y
CONFIG_AUDITSYSCALL=y
CONFIG_PROC_AVC=y
# ] SEC_SELINUX_PORTING_COMMON

# FIPS
CONFIG_CRYPTO_SKC_FIPS=y



CONFIG_UH=n




CONFIG_RKP=n




CONFIG_KDP=n




CONFIG_FIVE=n




CONFIG_PROCA=n




CONFIG_PROCA_S_OS=y




# CONFIG_FIVE_TEE_DRIVER is not set




# CONFIG_FIVE_PA_FEATURE is not set




CONFIG_FIVE_GKI_10=y




CONFIG_PROCA_GKI_10=y




CONFIG_GAF=y




CONFIG_GAF_V6=y












































































CONFIG_SECURITY_DEFEX=n




CONFIG_SECURITY_DEFEX_USER=y




CONFIG_SECURITY_DEFEX_DTM=y




CONFIG_SECURITY_DEFEX_IMR=y




CONFIG_SMB_SERVER=y




CONFIG_SMB_SERVER_CHECK_CAP_NET_ADMIN=y




CONFIG_SECURITY_DSMS=y




CONFIG_SECURITY_KUMIHO=y




CONFIG_NTFS3_FS=y












CONFIG_NTFS3_LZX_XPRESS=y












CONFIG_NLS=y












CONFIG_EROFS_FS=y












CONFIG_F2FS_FS=y












CONFIG_F2FS_FS_SECURITY=y












CONFIG_F2FS_FS_COMPRESSION=y












CONFIG_EXT4_FS_POSIX_ACL=y




CONFIG_UH_RKP=n
CONFIG_UH_LKMAUTH=n
CONFIG_UH_LKM_BLOCK=n
CONFIG_RKP_CFP_JOPP=n
CONFIG_RKP_CFP=n
```
